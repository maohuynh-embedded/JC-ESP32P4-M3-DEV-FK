## 1-Demo/IDF-DEMO/NoDisplay/uvc_camera_ov5647/sdkconfig.defaults.esp32p4
```kconfig
CONFIG_CAMERA_SC2336=y
CONFIG_ISP_ISR_IRAM_SAFE=y
CONFIG_ISP_CTRL_FUNC_IN_IRAM=y
CONFIG_IDF_EXPERIMENTAL_FEATURES=y
CONFIG_ESP_VIDEO_ENABLE_ISP_PIPELINE_CONTROLLER=y

CONFIG_SPIRAM=y

CONFIG_SPIRAM_SPEED_200M=y
```

## 10-Apps/uvc_camera_ov5647/sdkconfig.defaults.esp32p4
```kconfig
# ========================================
# ESP32-P4 UVC Camera Configuration
# ========================================

# ----------------------------------------
# Camera Sensor Configuration
# ----------------------------------------
# OV5647 - 5MP Camera Module
CONFIG_CAMERA_OV5647=y
CONFIG_CAMERA_OV5647_AUTO_DETECT=y
CONFIG_CAMERA_OV5647_AUTO_DETECT_MIPI_INTERFACE_SENSOR=y
CONFIG_CAMERA_OV5647_CSI_LINESYNC_ENABLE=y
CONFIG_CAMERA_OV5647_DEFAULT_IPA_JSON_CONFIGURATION_FILE=y
CONFIG_CAMERA_OV5647_ISP_AF_ENABLE=y
CONFIG_CAMERA_OV5647_MIPI_IF_FORMAT_INDEX_DAFAULT=3
CONFIG_CAMERA_OV5647_MIPI_RAW10_1920x1080_30FPS=y

# SC2336 - Alternative Camera Sensor
CONFIG_CAMERA_SC2336=y
CONFIG_CAMERA_SC2336_ABSOLUTE_GAIN_LIMIT=66016
CONFIG_CAMERA_SC2336_AUTO_DETECT=y
CONFIG_CAMERA_SC2336_AUTO_DETECT_MIPI_INTERFACE_SENSOR=y
CONFIG_CAMERA_SC2336_DEFAULT_IPA_JSON_CONFIGURATION_FILE=y
CONFIG_CAMERA_SC2336_DIG_GAIN_PRIORITY=y
CONFIG_CAMERA_SC2336_DVP_IF_FORMAT_INDEX_DAFAULT=12
CONFIG_CAMERA_SC2336_DVP_RAW10_1280x720_30FPS=y
CONFIG_CAMERA_SC2336_MIPI_IF_FORMAT_INDEX_DAFAULT=9
CONFIG_CAMERA_SC2336_MIPI_RAW8_1280x720_30FPS=y

# Camera Clock Configuration
CONFIG_CAMERA_XCLK_USE_ESP_CLOCK_ROUTER=y

# ----------------------------------------
# ISP (Image Signal Processor)
# ----------------------------------------
CONFIG_ESP_VIDEO_ENABLE_ISP_PIPELINE_CONTROLLER=y
CONFIG_ISP_ISR_IRAM_SAFE=y
CONFIG_ISP_CTRL_FUNC_IN_IRAM=y

# ----------------------------------------
# Example/Application Configuration
# ----------------------------------------
CONFIG_EXAMPLE_CAM_SENSOR_MIPI_CSI=y
CONFIG_EXAMPLE_JPEG_COMPRESSION_QUALITY=80
CONFIG_EXAMPLE_MIPI_CSI_SCCB_I2C_FREQ=100000
CONFIG_EXAMPLE_MIPI_CSI_SCCB_I2C_PORT=0
CONFIG_EXAMPLE_MIPI_CSI_SCCB_I2C_SCL_PIN=8
CONFIG_EXAMPLE_MIPI_CSI_SCCB_I2C_SDA_PIN=7

# ----------------------------------------
# UVC (USB Video Class) Configuration
# ----------------------------------------
# Camera 1 Configuration
CONFIG_UVC_CAM1_FRAMERATE=30
CONFIG_UVC_CAM1_FRAMESIZE_HEIGT=1080
CONFIG_UVC_CAM1_FRAMESIZE_WIDTH=1920
CONFIG_UVC_CAM1_MULTI_FRAMESIZE=y
CONFIG_UVC_CAM1_TASK_PRIORITY=4

# UVC Transfer Mode
CONFIG_UVC_MODE_ISOC_CAM1=y

# Multiple Frame Size Support
CONFIG_UVC_MULTI_FRAME_FPS_1=15
CONFIG_UVC_MULTI_FRAME_FPS_2=30
CONFIG_UVC_MULTI_FRAME_FPS_3=30
CONFIG_UVC_MULTI_FRAME_HEIGHT_1=720
CONFIG_UVC_MULTI_FRAME_HEIGHT_2=320
CONFIG_UVC_MULTI_FRAME_HEIGHT_3=240
CONFIG_UVC_MULTI_FRAME_WIDTH_1=1280
CONFIG_UVC_MULTI_FRAME_WIDTH_2=480
CONFIG_UVC_MULTI_FRAME_WIDTH_3=320

# TinyUSB Task Priority
CONFIG_UVC_TINYUSB_TASK_PRIORITY=5

# ----------------------------------------
# USB Configuration
# ----------------------------------------
CONFIG_USB_OTG_SUPPORTED=y
CONFIG_USB_HOST_CONTROL_TRANSFER_MAX_SIZE=256
CONFIG_USB_HOST_DEBOUNCE_DELAY_MS=250
CONFIG_USB_HOST_HW_BUFFER_BIAS_BALANCED=y
CONFIG_USB_HOST_RESET_HOLD_MS=30
CONFIG_USB_HOST_RESET_RECOVERY_MS=30
CONFIG_USB_HOST_SET_ADDR_RECOVERY_MS=10

# ----------------------------------------
# SPIRAM (External PSRAM) Configuration
# ----------------------------------------
CONFIG_SPIRAM=y
CONFIG_SPIRAM_SPEED_200M=y
CONFIG_SPIRAM_SPEED=200
CONFIG_SPIRAM_MODE_HEX=y

# SPIRAM Memory Features
CONFIG_SPIRAM_BOOT_INIT=y
CONFIG_SPIRAM_BOOT_HW_INIT=y
CONFIG_SPIRAM_USE_MALLOC=y
CONFIG_SPIRAM_MEMTEST=y

# SPIRAM XIP (Execute In Place)
CONFIG_SPIRAM_FETCH_INSTRUCTIONS=y
CONFIG_SPIRAM_RODATA=y
CONFIG_SPIRAM_XIP_FROM_PSRAM=y
CONFIG_SPIRAM_FLASH_LOAD_TO_PSRAM=y
CONFIG_SPIRAM_PRE_CONFIGURE_MEMORY_PROTECTION=y

# SPIRAM Allocation Settings
CONFIG_SPIRAM_MALLOC_ALWAYSINTERNAL=16384
CONFIG_SPIRAM_MALLOC_RESERVE_INTERNAL=32768

# ----------------------------------------
# FreeRTOS Configuration
# ----------------------------------------
CONFIG_FREERTOS_HZ=100
CONFIG_FREERTOS_NUMBER_OF_CORES=2
CONFIG_FREERTOS_NO_AFFINITY=0x7FFFFFFF

# Task Configuration
CONFIG_FREERTOS_MAX_TASK_NAME_LEN=16
CONFIG_FREERTOS_IDLE_TASK_STACKSIZE=1536
CONFIG_FREERTOS_ISR_STACKSIZE=1536
CONFIG_FREERTOS_TASK_NOTIFICATION_ARRAY_ENTRIES=1
CONFIG_FREERTOS_THREAD_LOCAL_STORAGE_POINTERS=1
CONFIG_FREERTOS_TASK_CREATE_ALLOW_EXT_MEM=y

# Timer Configuration
CONFIG_FREERTOS_USE_TIMERS=y
CONFIG_FREERTOS_TIMER_TASK_PRIORITY=1
CONFIG_FREERTOS_TIMER_TASK_STACK_DEPTH=2048
CONFIG_FREERTOS_TIMER_QUEUE_LENGTH=10
CONFIG_FREERTOS_TIMER_SERVICE_TASK_NAME="Tmr Svc"
CONFIG_FREERTOS_TIMER_TASK_NO_AFFINITY=y
CONFIG_FREERTOS_TIMER_SERVICE_TASK_CORE_AFFINITY=0x7FFFFFFF

# FreeRTOS Features
CONFIG_FREERTOS_PORT=y
CONFIG_FREERTOS_SUPPORT_STATIC_ALLOCATION=y
CONFIG_FREERTOS_ENABLE_TASK_SNAPSHOT=y
CONFIG_FREERTOS_PLACE_SNAPSHOT_FUNS_INTO_FLASH=y
CONFIG_FREERTOS_QUEUE_REGISTRY_SIZE=0
CONFIG_FREERTOS_TASK_FUNCTION_WRAPPER=y
CONFIG_FREERTOS_TLSP_DELETION_CALLBACKS=y

# FreeRTOS Debugging
CONFIG_FREERTOS_CHECK_STACKOVERFLOW_CANARY=y
CONFIG_FREERTOS_CHECK_MUTEX_GIVEN_BY_OWNER=y
CONFIG_FREERTOS_DEBUG_OCDAWARE=y
CONFIG_FREERTOS_INTERRUPT_BACKTRACE=y

# FreeRTOS System Timer
CONFIG_FREERTOS_SYSTICK_USES_SYSTIMER=y
CONFIG_FREERTOS_TICK_SUPPORT_SYSTIMER=y
CONFIG_FREERTOS_CORETIMER_SYSTIMER_LVL1=y

# FreeRTOS Memory Placement
CONFIG_FREERTOS_IN_IRAM=y

# ----------------------------------------
# Flash & Partition Configuration
# ----------------------------------------
CONFIG_ESPTOOLPY_FLASHMODE_QIO=y
CONFIG_PARTITION_TABLE_SINGLE_APP=y
CONFIG_PARTITION_TABLE_OFFSET=0x8000
CONFIG_PARTITION_TABLE_FILENAME="partitions_singleapp.csv"
CONFIG_PARTITION_TABLE_MD5=y

# ----------------------------------------
# ESP32-P4 Chip Configuration
# ----------------------------------------
CONFIG_ESP32P4_REV_MIN_1=y
CONFIG_ESP32P4_REV_MIN_FULL=1
CONFIG_ESP32P4_REV_MAX_FULL=199
CONFIG_ESP32P4_UNIVERSAL_MAC_ADDRESSES_ONE=y
CONFIG_ESP32P4_UNIVERSAL_MAC_ADDRESSES=1

# ----------------------------------------
# Experimental Features
# ----------------------------------------
CONFIG_IDF_EXPERIMENTAL_FEATURES=y
```
